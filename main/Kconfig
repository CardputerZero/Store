## main/Kconfig
```kconfig
# SPDX-FileCopyrightText: 2026 M5Stack Technology CO LTD
# SPDX-License-Identifier: MIT

menu "VibAPP"

config VIBAPP_PLACEHOLDER
    bool "Placeholder"
    default y

endmenu
```
